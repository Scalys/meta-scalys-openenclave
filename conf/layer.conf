## conf/layer.conf
```bitbake
BBPATH .= ":${LAYERDIR}"

BBFILES += "${LAYERDIR}/recipes-*/*/*.bb \
            ${LAYERDIR}/recipes-*/*/*.bbappend"

BBFILE_COLLECTIONS += "meta-scalys-openenclave"
BBFILE_PATTERN_meta-scalys-openenclave = "^${LAYERDIR}/"
BBFILE_PRIORITY_meta-scalys-openenclave = "6"

LAYERDEPENDS_meta-scalys-openenclave = "core"
LAYERSERIES_COMPAT_meta-scalys-openenclave = "dunfell"
```
